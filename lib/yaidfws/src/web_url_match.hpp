#pragma once

// #include "list_entities.h"

#ifdef USE_WEBSERVER
// #include "esphome/core/component.h"
// #include "esphome/core/controller.h"
// #include "esphome/core/entity_base.h"

#include <map>
#include <vector>
#include <freertos/FreeRTOS.h>
#include <freertos/semphr.h>
#include <string>
#include <regex>

#include "web_url_match.hpp"

namespace yaidfws
{
    /// Internal helper struct that is used to parse incoming URLs
    /// Тут находится результат работы разбора url
    // struct UrlMatch
    //{
    //     std::string domain; ///< The domain of the component, for example "sensor"
    //     std::string id;     ///< The id of the device that's being accessed, for example "living_room_fan"
    //     std::string method; ///< The method that's being called, for example "turn_on"
    //     bool valid;         ///< Whether this match is valid
    // };
    //
    // UrlMatch match_url(const std::string &url, bool only_domain = false);

    /// @brief Generated by Grok 3

    /**
     * @class UrlParserBase
     * @brief A utility Фbstract class for parsing URLs into their components and query parameters.
     *
     * The UrlParser class provides a simple and efficient way to break down a URL string
     * into its constituent parts, such as protocol, host, path, and query string. It also
     * extracts query parameters into a key-value map for easy access. This class is designed
     * to be lightweight and suitable for embedded systems like ESP32, with minimal dependencies
     * on the C++ Standard Library (e.g., std::string and std::map).
     *
     * @note This implementation does not decode URL-encoded characters (e.g., %20). For such
     * functionality, additional decoding methods can be added.
     *
     * Class and comments originally generated by Grok 3.
     *
     * @example
     *   UrlParser parser("http://example.com/api?key1=value1&key2=value2");
     *   std::string host = parser.getHost();  // Returns "example.com"
     *   std::string param = parser.getParam("key1");  // Returns "value1"
     */
    class UrlParser
    {
    public:
        // Virtual destructor for proper deletion through a base class pointer
        virtual ~UrlParser() = default;

        // Pure virtual methods for accessing URL components
        virtual std::string getProtocol() const = 0;
        virtual std::string getHost() const = 0;
        virtual std::string getPath() const = 0;
        virtual std::string getQueryString() const = 0;

        // Pure virtual methods for working with parameters
        virtual std::string getParam(const std::string &key) const = 0;
        virtual bool hasParam(const std::string &key) const = 0;
        virtual const std::map<std::string, std::string> &getParams() const = 0;

        const std::string toStr() const
        {
            std::string str;
            str.reserve(64);
            str.append("Protocol: ").append(getProtocol()).append(", Host: ").append(getHost()).append(", Path: ").append(getPath()).append(", QueryString: ").append(getQueryString());

            const auto &params = getParams();
            if (!params.empty())
            {
                str.append(", Params:[");

                bool first = true;
                for (const auto &[key, value] : params)
                {
                    if (!first)
                        str.append("; ");
                    str.append(key).append("=").append(value);
                    first = false;
                }
                str.append("]");
            }

            return str;
        };
    };

    // Class for manual URL parsing
    class UrlParserManual : public UrlParser
    {
    private:
        std::string protocol_;                      // E.g., "http" or "https"
        std::string host_;                          // E.g., "example.com"
        std::string path_;                          // E.g., "/api/v1"
        std::string query_;                         // Full query string, e.g., "key1=value1&key2=value2"
        std::map<std::string, std::string> params_; // Query parameters
    public:
        // Parse the URL into components
        explicit UrlParserManual(const std::string &url)
        {
            parse(url);
        }

        // Get URL components
        std::string getProtocol() const override { return protocol_; }
        std::string getHost() const override { return host_; }
        std::string getPath() const override { return path_; }
        std::string getQueryString() const override { return query_; }

        // Get the value of a parameter by key
        std::string getParam(const std::string &key) const override
        {
            auto it = params_.find(key);
            return (it != params_.end()) ? it->second : "";
        }

        // Check if a parameter exists
        bool hasParam(const std::string &key) const override
        {
            return params_.find(key) != params_.end();
        }

        // Get all parameters as a map
        const std::map<std::string, std::string> &getParams() const override
        {
            return params_;
        }

    private:
        void parse(const std::string &url)
        {
            // По умолчанию путь — "/"
            path_ = "/";

            // Ищем протокол
            size_t proto_end = url.find("://");
            if (proto_end != std::string::npos)
            {
                protocol_ = url.substr(0, proto_end);
                proto_end += 3; // Пропускаем "://"
            }
            else
            {
                proto_end = 0; // Нет протокола, начинаем с хоста
            }

            // Ищем конец хоста (перед путём или запросом)
            size_t path_start = url.find('/', proto_end);
            size_t query_start = url.find('?', proto_end);

            // Если нет пути и запроса, весь остаток — хост
            if (path_start == std::string::npos && query_start == std::string::npos)
            {
                host_ = url.substr(proto_end);
                return;
            }

            // Определяем границы хоста
            size_t host_end = (path_start != std::string::npos) ? path_start : query_start;
            if (host_end != std::string::npos)
            {
                host_ = url.substr(proto_end, host_end - proto_end);
            }

            // Определяем путь
            if (path_start != std::string::npos)
            {
                size_t path_end = (query_start != std::string::npos) ? query_start : std::string::npos;
                path_ = (path_end == std::string::npos)
                            ? url.substr(path_start)
                            : url.substr(path_start, path_end - path_start);
            }

            // Парсим строку запроса
            if (query_start != std::string::npos)
            {
                query_ = url.substr(query_start + 1);
                parseQuery(query_);
            }
        }

        void parseQuery(const std::string &query)
        {
            if (query.empty())
                return;

            size_t start = 0;
            while (start < query.length())
            {
                // Ищем конец текущей пары ключ=значение
                size_t amp = query.find('&', start);
                if (amp == std::string::npos)
                    amp = query.length();

                // Извлекаем пару
                std::string pair = query.substr(start, amp - start);
                size_t eq = pair.find('=');
                if (eq != std::string::npos)
                {
                    std::string key = pair.substr(0, eq);
                    std::string value = pair.substr(eq + 1);
                    params_[key] = value;
                }
                else if (!pair.empty())
                {
                    params_[pair] = ""; // Параметр без значения
                }

                start = amp + 1;
            }
        }
    };

    // Class for parsing URLs using regular expressions
    class UrlParserRegex : public UrlParser
    {
    public:
        explicit UrlParserRegex(const std::string &url)
        {
            parse(url);
        }

        std::string getProtocol() const override { return protocol_; }
        std::string getHost() const override { return host_; }
        std::string getPath() const override { return path_; }
        std::string getQueryString() const override { return query_; }

        // Overridden methods for working with parameters
        std::string getParam(const std::string &key) const override
        {
            auto it = params_.find(key);
            return (it != params_.end()) ? it->second : "";
        }
        bool hasParam(const std::string &key) const override
        {
            return params_.find(key) != params_.end();
        }
        const std::map<std::string, std::string> &getParams() const override
        {
            return params_;
        }

    private:
        std::string protocol_;
        std::string host_;
        std::string path_;
        std::string query_;
        std::map<std::string, std::string> params_;

        void parse(const std::string &url)
        {
            // Регулярное выражение для разбора URL
            std::regex urlRegex(
                R"(^(([^:/?#]+):)?//([^/?#]*)([^?#]*)(\?([^#]*))?)",
                std::regex::ECMAScript);
            std::smatch matches;

            if (std::regex_match(url, matches, urlRegex))
            {
                protocol_ = matches[2];                              // Группа 2: протокол (http, https)
                host_ = matches[3];                                  // Группа 3: хост (example.com)
                path_ = matches[4].matched ? matches[4].str() : "/"; // Группа 4: путь
                query_ = matches[6];                                 // Группа 6: строка запроса (key=value&...)
            }

            // Разбор параметров запроса
            if (!query_.empty())
            {
                std::regex paramRegex(R"(([^\?&]+)=([^&]*))");
                auto paramsBegin = std::sregex_iterator(
                    query_.begin(), query_.end(), paramRegex);
                auto paramsEnd = std::sregex_iterator();

                for (auto it = paramsBegin; it != paramsEnd; ++it)
                {
                    params_[(*it)[1]] = (*it)[2];
                }
            }
        }
    };

    /* For test

    #include <iostream>

    int main() {
    std::string url = "http://example.com/api/v1?key1=value1&key2=value2&flag";
    UrlParser parser(url);

    // Вывод компонентов
    std::cout << "Protocol: " << parser.getProtocol() << std::endl;  // "http"
    std::cout << "Host: " << parser.getHost() << std::endl;        // "example.com"
    std::cout << "Path: " << parser.getPath() << std::endl;        // "/api/v1"
    std::cout << "Query: " << parser.getQueryString() << std::endl; // "key1=value1&key2=value2&flag"

    // Вывод параметров
    std::cout << "key1: " << parser.getParam("key1") << std::endl; // "value1"
    std::cout << "key2: " << parser.getParam("key2") << std::endl; // "value2"
    std::cout << "flag: " << parser.getParam("flag") << std::endl; // "" (пустая строка)
    std::cout << "missing: " << parser.getParam("missing") << std::endl; // "" (нет ключа)

    // Проверка наличия параметра
    std::cout << "Has 'key1'? " << (parser.hasParam("key1") ? "Yes" : "No") << std::endl; // "Yes"

    return 0;

    */

} // namespace yaidfws

#endif // USE_WEBSERVER